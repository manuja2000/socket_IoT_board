## prj.conf
```kconfig
# General config
CONFIG_NEWLIB_LIBC=y
CONFIG_MAIN_STACK_SIZE=1200

# Networking config
CONFIG_NETWORKING=y
CONFIG_NET_IPV4=y
CONFIG_NET_IPV6=n
CONFIG_NET_TCP=y
CONFIG_NET_SOCKETS=y
CONFIG_NET_SOCKETS_POSIX_NAMES=y

# Network driver config
CONFIG_TEST_RANDOM_GENERATOR=y

# Network shell
CONFIG_NET_SHELL=y
CONFIG_SHELL=y
CONFIG_NET_L2_WIFI_SHELL=y
CONFIG_WIFI=y

# Network address config
CONFIG_NET_CONFIG_SETTINGS=y
CONFIG_NET_CONFIG_NEED_IPV4=y
```

## boards/wifi-shell-overlay.conf
```kconfig
CONFIG_SHELL=y
CONFIG_NET_L2_WIFI_SHELL=y
CONFIG_NET_SOCKETS_POSIX_NAMES=n
CONFIG_DEBUG=y
```

## src/config.h
```c
/*
 * config.h
 */

#ifndef SRC_CONFIG_H_
#define SRC_CONFIG_H_

// Auto join 0 - Disabled, 1 - Enable
#define AUTO_CONNECT  		1

// SSID
#define AUTO_CONNECT_SSID 	"your ssid"

// Password
#define AUTO_CONNECT_SSID_PSK	"your password"

//Security type WIFI_SECURITY_TYPE_NONE = 0, WIFI_SECURITY_TYPE_PSK = 1
#define SSID_SECURITY	WIFI_SECURITY_TYPE_PSK

#endif /* SRC_CONFIG_H_ */
```

## src/socket_echo.c
```c
/*
 * Copyright (c) 2017 Linaro Limited
 *
 * SPDX-License-Identifier: Apache-2.0
 */

#include <stdio.h>
#include <stdlib.h>
#include <errno.h>
#include "wifi_demo.h"

#ifndef __ZEPHYR__

#include <netinet/in.h>
#include <sys/socket.h>
#include <arpa/inet.h>
#include <unistd.h>

#else

#include <net/socket.h>
#include <kernel.h>

#endif

#define BIND_PORT 4242

void main(void)
{
	Wifi_demo();
	int serv;
	struct sockaddr_in bind_addr;
	static int counter;

	serv = socket(AF_INET, SOCK_STREAM, IPPROTO_TCP);

	if (serv < 0) {
		printf("error: socket: %d\n", errno);
		exit(1);
	}

	bind_addr.sin_family = AF_INET;
	bind_addr.sin_addr.s_addr = htonl(INADDR_ANY);
	bind_addr.sin_port = htons(BIND_PORT);

	if (bind(serv, (struct sockaddr *)&bind_addr, sizeof(bind_addr)) < 0) {
		printf("error: bind: %d\n", errno);
		exit(1);
	}

	if (listen(serv, 5) < 0) {
		printf("error: listen: %d\n", errno);
		exit(1);
	}

	printf("Single-threaded TCP echo server waits for a connection on "
	       "port %d...\n", BIND_PORT);

	while (1) {
		struct sockaddr_in client_addr;
		socklen_t client_addr_len = sizeof(client_addr);
		char addr_str[32];
		printf("Before Accept\n");
		int client = accept(serv, (struct sockaddr *)&client_addr,
				    &client_addr_len);
		printf("After Accept\n");
		if (client < 0) {
			printf("error: accept: %d\n", errno);
			continue;
		}
		

		inet_ntop(client_addr.sin_family, &client_addr.sin_addr,
			  addr_str, sizeof(addr_str));
		printf("Connection #%d from %s\n", counter++, addr_str);

		while (1) {
			char buf[128], *p;
			int len = recv(client, buf, sizeof(buf), 0);
			int out_len;

			if (len <= 0) {
				if (len < 0) {
					printf("error: recv: %d\n", errno);
				}
				break;
			}

			p = buf;
			do {
				out_len = send(client, p, len, 0);
				if (out_len < 0) {
					printf("error: send: %d\n", errno);
					goto error;
				}
				p += out_len;
				len -= out_len;
			} while (len);
		}

error:
		close(client);
		printf("Connection from %s closed\n", addr_str);
	}
}
```

## src/wifi_demo.c
```c
/*
 * wifi_demo.c
 */

#include <stdio.h>

#include <zephyr.h>
#include <device.h>
#include <devicetree.h>
#include <drivers/gpio.h>

#include <net/wifi.h>
#include <net/net_if.h>
#include <net/net_event.h>
#include <net/net_mgmt.h>
#include <net/wifi_mgmt.h>

#include <string.h>

#include "config.h"

#if AUTO_CONNECT
#ifndef DT_N_NODELABEL_wifi0
#error "Unsupported board: wifi0 is not defined in the devicetree"
#endif

#define perror(fmt, args...)						\
do {									\
	printf("Error: " fmt "(): %d\n" ## args, errno );	\
	while(1); \
} while (0)								\


#define WIFI_MGMT_EVENTS (NET_EVENT_WIFI_SCAN_RESULT |		\
				NET_EVENT_WIFI_SCAN_DONE |		\
				NET_EVENT_WIFI_CONNECT_RESULT |		\
				NET_EVENT_WIFI_DISCONNECT_RESULT)


static struct net_mgmt_event_callback cb;
static struct k_sem net_cb_sem;


static void Wifi_check_connect_result( struct net_if *iface, struct net_mgmt_event_callback *cb)
{
	const struct wifi_status *status = (const struct wifi_status *) cb->info;
	if (!status->status) {
		// Connected
		k_sem_give(&net_cb_sem);
	}
}


void Wifi_event_listener( struct net_mgmt_event_callback *cb, uint32_t mgmt_event, struct net_if *iface ) {
	switch( mgmt_event ) {
		case NET_EVENT_WIFI_CONNECT_RESULT:
			Wifi_check_connect_result( iface, cb );
			break;
	}
}

int Wifi_autoconnect() {
	struct wifi_connect_req_params wifi_args;
	wifi_args.security = WIFI_SECURITY_TYPE_PSK;
	wifi_args.channel = WIFI_CHANNEL_ANY;
	wifi_args.psk = AUTO_CONNECT_SSID_PSK;
	wifi_args.psk_length = strlen(AUTO_CONNECT_SSID_PSK);
	wifi_args.ssid = AUTO_CONNECT_SSID;
	wifi_args.ssid_length = strlen(AUTO_CONNECT_SSID);

	// Init semaphore
	k_sem_init(&net_cb_sem, 0, 1);

	// Configure Callback
	net_mgmt_init_event_callback(&cb, Wifi_event_listener, WIFI_MGMT_EVENTS );
	net_mgmt_add_event_callback(&cb);

	// Connect interface to network
	struct net_if *iface = net_if_get_default();
	if( net_mgmt( NET_REQUEST_WIFI_CONNECT, iface, &wifi_args, sizeof(wifi_args) ) ) {
		perror("Failed to request connection to SSID "AUTO_CONNECT_SSID);
	}

	// Wait for connection.....
	k_sem_take(&net_cb_sem, K_FOREVER );

	struct net_if_ipv4 *ipv4 = iface->config.ip.ipv4;
	static char buf[NET_IPV4_ADDR_LEN];
	net_addr_ntop( AF_INET, (const char *)&ipv4->unicast[0].address.in_addr, buf, NET_IPV4_ADDR_LEN);
	printk("\r\nSucessfull connected to SSID:["AUTO_CONNECT_SSID"]\r\nAssigned IP address [%s] \r\n", buf );

	return 0;
}
#endif

void Wifi_demo(void)
{

#if AUTO_CONNECT
	Wifi_autoconnect();
#endif

}
```

## src/wifi_demo.h
```c
/*
 * wifi_demo.h
 */

#ifndef SRC_WIFI_DEMO_H_
#define SRC_WIFI_DEMO_H_

// Declare demo funtion
void Wifi_demo(void);

#endif /* SRC_WIFI_DEMO_H_ */
```
